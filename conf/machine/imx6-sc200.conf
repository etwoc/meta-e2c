## conf/machine/imx6-sc200.conf
```bitbake
#@TYPE: Machine
#@NAME: mx6-sc200
#@SOC:  i.MX6
#@DESCRIPTION: Machine configuration for e2c mx6 SC200

include conf/machine/include/imx-base.inc
include conf/machine/include/tune-cortexa7.inc

#SOC_FAMILY = "mx6ul"
MACHINEOVERRIDES =. "mx6:mx6ul:"

IMAGE_FSTYPES += "tar.bz2 sdcard"

PREFERRED_PROVIDER_virtual/kernel ?= "linux-fslc-e2c"

KERNEL_IMAGETYPE = "zImage"
KERNEL_DEVICETREE = "imx6dl-sc200-ldo.dtb"

PREFERRED_PROVIDER_u-boot ??= "u-boot-e2c"
PREFERRED_PROVIDER_virtual/bootloader ??= "u-boot-e2c"

WKS_FILE = "imx-uboot-spl-bootpart.wks"
UBOOT_MACHINE ?= "mx6_sc200_defconfig"
SPL_BINARY = "SPL"
UBOOT_SUFFIX = "img"
UBOOT_MAKE_TARGET = "all"
#UBOOT_CONFIG ??= "sd"
#UBOOT_CONFIG[sd] = "mx6_sc200_config,sdcard"

MACHINE_FEATURES+= "pci wifi blutooth"
```

## conf/machine/imx6ul-sc100.conf
```bitbake
#@TYPE: Machine
#@NAME: mx6ul-sc100
#@SOC:  i.MX6UL
#@DESCRIPTION: Machine configuration for e2c mx6ul SC100

include conf/machine/include/imx-base.inc
include conf/machine/include/tune-cortexa7.inc

#SOC_FAMILY = "mx6ul"
MACHINEOVERRIDES =. "mx6:mx6ul:"

IMAGE_FSTYPES  = "tar.bz2"

PREFERRED_PROVIDER_virtual/kernel ?= "linux-e2c"

KERNEL_IMAGETYPE = "zImage"
KERNEL_DEVICETREE = "imx6ul-sc100.dtb"

PREFERRED_PROVIDER_u-boot = "u-boot-e2c"
#PREFERRED_PROVIDER_u-boot_mx6ul = "u-boot--e2c"
PREFERRED_PROVIDER_virtual/bootloader ?= "u-boot-e2c"

SPL_BINARY = "SPL"
UBOOT_SUFFIX = "img"
UBOOT_MAKE_TARGET = ""
UBOOT_CONFIG ??= "sd"
UBOOT_CONFIG[sd] = "mx6ul_sc100_config,sdcard"

MACHINE_FEATURES+= "pci wifi bluetooth"

PREFERRED_PROVIDER_wpa-supplicant-cli = "wpa-supplicant"
PREFERRED_PROVIDER_wpa-supplicant-passphrase = "wpa-supplicant"
PREFERRED_PROVIDER_wpa-supplicant = "wpa-supplicant"

MACHINE_EXTRA_RDEPENDS += "\
					i2c-tools \
					devmem2 \
					fb-test \
					fbida \
					evtest \
					qrencode \
					socat \
					curl \
					ppp \
					openssh \
					setserial \
					picocom \
					ntp \
					flex \
					gcc \
					git \
					m4 \
					make \
					libtool \
					nano \
					python3 \
					kernel-modules \
			        packagegroup-tools-bluetooth \
 				    crda \
					iw \			      
                	wpa-supplicant \
				    ti-wifi-utils \
                    wl18xx-firmware \
				    wl18xx-target-scripts \
    				wlconf \
					rpm \
					mosquitto \
					paho-mqtt-c \
"
# Packages added to all images (including core-image-minimal)
IMAGE_INSTALL_append = " \
        fsl-rc-local \
"
```
